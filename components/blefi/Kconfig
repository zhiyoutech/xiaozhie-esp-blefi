## components/blefi/Kconfig
```kconfig
menu "Blefi Component Configuration"

config SSID_PASSWORD_BY_BLE
    bool "Enable Blefi Component"
    default y
    help
        Enable or disable Blefi component functionality.

endmenu
```
